VERSION ""

NS_ :

BS_:

BU_:

BO_ 100 ActualVehicleSpeed: 8 Vector__XXX
 SG_ ActualVehicleSpeed : 0|24@1+ (0.5,0.0) [0|320] "kph" Vector__XXX

BO_ 202 ChargeLevel: 8 Vector__XXX
 SG_ ChargeLevel : 0|24@1+ (0.25,-100.0) [-100|1000] "%" Vector__XXX

BO_ 500 GreenLed: 8 Vector__XXX
  SG_ GreenLed : 0|24@1+ (1,0.0) [0|255] "status" Vector__XXX

BO_ 604 VehicleStatus: 8 Vector__XXX
  SG_ VehicleStatus : 0|24@1+ (1,0.0) [0|1000] "" Vector__XXX

BO_ 605 BatteryPackVoltage: 8 Vector__XXX
  SG_ BatteryPackVoltage : 0|24@1+ (1,0.0) [0|10000] "v" Vector__XXX

BO_ 502 RedLed: 8 Vector__XXX
  SG_ RedLed : 0|24@1+ (1,0) [0|255] "status" Vector__XXX

BA_DEF_ BO_  "GenMsgCycleTime" INT 0 10000;
BA_DEF_DEF_  "GenMsgCycleTime" 50;
